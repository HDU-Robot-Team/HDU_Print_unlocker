//Drive_IC:SSD1306
//=-=-=-=-=-=-=-=-=-=-=-=-=-=-=-=-=-=-=-=-=-=-=-=-=-=-=-=-=-=-=-=-=-=-=-=-=-=-=-=-=-=-=-=-=-=-=-=-=-=

//#include <at89x51.h>
#include "oled4p.h"

const unsigned char Hzk[][32]=
{
{0x08,0x08,0xF9,0x4A,0x48,0xC8,0x48,0x20,0xD8,0x17,0x10,0x10,0xF0,0x10,0x10,0x00},
{0x40,0x30,0x0F,0x20,0x40,0x3F,0x80,0x40,0x21,0x16,0x08,0x16,0x21,0x40,0x80,0x00},//"放"0
{0x00,0x17,0x15,0xD5,0x55,0x57,0x55,0x7D,0x55,0x57,0x55,0xD5,0x15,0x17,0x00,0x00},
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{0x01,0x01,0x01,0x7F,0x21,0x11,0x80,0x4F,0x20,0x10,0x0F,0x10,0x20,0x4F,0x80,0x00},//锁73
};

const unsigned char F8X16[]=	  
{
  0x00,0x00,0x00,0x00,0x00,0x00,0x00,0x00,0x00,0x00,0x00,0x00,0x00,0x00,0x00,0x00,// 0
  0x00,0x00,0x00,0xF8,0x00,0x00,0x00,0x00,0x00,0x00,0x00,0x33,0x30,0x00,0x00,0x00,//! 1
  0x00,0x10,0x0C,0x06,0x10,0x0C,0x06,0x00,0x00,0x00,0x00,0x00,0x00,0x00,0x00,0x00,//" 2
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	0xF0,0xE0,0xE0,0xC0,0xC0,0x80,0x80,0x00,0x1F,0x0F,0x0F,0x07,0x07,0x03,0x03,0x01 //箭头 96 0x80
};
//-=-=-=-=-=-=-=-=-=-=-=-=-=-=-=-=-=-=-=-=-=-=-=-=-=-=-=-=-=-=-=-=-=-=-=
//  Read/Write Sequence
//-=-=-=-=-=-=-=-=-=-=-=-=-=-=-=-=-=-=-=-=-=-=-=-=-=-=-=-=-=-=-=-=-=-=-=
void OLED_WriteByte(Uchar mcmd)
{
Uchar length = 8;			// Send Command

	while(length--)
	{
		if(mcmd & 0x80)
		{
			setSDA;
		}
		else
		{
			resetSDA;
		}
//		delay_us(50);
		setSCL;
//		delay_us(50);
		resetSCL;
//		delay_us(50);
		mcmd = mcmd << 1;
	}
}


void I2C_Ack3()
{
	setSDA;
//	delay_us(50);
	setSCL;
//	delay_us(50);
	resetSCL;
//	delay_us(50);
}


void I2C_NAck3()
{
	resetSDA;
//	delay_us(50);
	setSCL;
//	delay_us(50);
	resetSCL;
//	delay_us(50);
}


void I2C_Start3()
{
	resetSDA;
//	delay_us(50);
	setSCL;
//	delay_us(50);
	resetSCL;
//	delay_us(50);
	OLED_WriteByte(0x78);
	I2C_Ack3();
}


void I2C_Stop3()
{
	setSCL;
//	delay_us(50);
	resetSDA;
//	delay_us(50);
	setSDA;
//	delay_us(50);
}


void OLED_WriteCommand(Uchar Data)
{
	I2C_Start3();
	OLED_WriteByte(0x00);
	I2C_Ack3();
	OLED_WriteByte(Data);
	I2C_Ack3();
	I2C_Stop3();
}


void OLED_WriteData(Uchar Data)
{
	I2C_Start3();
	OLED_WriteByte(0x40);
	I2C_Ack3();
	OLED_WriteByte(Data);
	I2C_Ack3();
	I2C_Stop3();
}
//-=-=-=-=-=-=-=-=-=-=-=-=-=-=-=-=-=-=-=-=-=-=-=-=-=-=-=-=-=-=-=-=-=-=-=

void OLED_Init(void){
//RES3=0;
//uDelay(2);
//RES3=1;
//internal setting


	

OLED_WriteCommand(0xae);	//--turn off oled panel

OLED_WriteCommand(0x00);	//--set low column address
OLED_WriteCommand(0x10);	//--set high column address

OLED_WriteCommand(0x40);	//--set start line address

OLED_WriteCommand(0xb0);	//--set page address

OLED_WriteCommand(0x81);	//--set contrast control register
OLED_WriteCommand(0xff);

OLED_WriteCommand(0xa1);	//--set segment re-map 127 to 0   a0:0 to seg127
OLED_WriteCommand(0xa6);	//--set normal display

OLED_WriteCommand(0xc8);	//--set com(N-1)to com0  c0:com0 to com(N-1)

OLED_WriteCommand(0xa8);	//--set multiples ratio(1to64)
OLED_WriteCommand(0x3f);	//--1/64 duty

OLED_WriteCommand(0xd3);	//--set display offset
OLED_WriteCommand(0x00);	//--not offset

OLED_WriteCommand(0xd5);	//--set display clock divide ratio/oscillator frequency
OLED_WriteCommand(0x80);	//--set divide ratio

OLED_WriteCommand(0xd9);	//--set pre-charge period
OLED_WriteCommand(0xf1);

OLED_WriteCommand(0xda);	//--set com pins hardware configuration
OLED_WriteCommand(0x12);

OLED_WriteCommand(0xdb);	//--set vcomh
OLED_WriteCommand(0x40);

OLED_WriteCommand(0x8d);	//--set chare pump enable/disable
OLED_WriteCommand(0x14);	//--set(0x10) disable
//OLED_WriteCommand(0x10);	//--set(0x10) disable
OLED_WriteCommand(0xaf);	//--turn on oled panel

OLED_Clean();

}

void OLED_SetPos(Uchar x,Uchar page){
	OLED_WriteCommand(0xb0+page);
	OLED_WriteCommand(((x&0xf0)>>4)|0x10);
	OLED_WriteCommand((x&0x0f)|0x01); 
}
void OLED_ShowChar(Uchar x,Uchar y,char chr){//x(0 to 15) y(0 to 3)
	unsigned char c=chr-' ',i=0;
	unsigned char page=y*2;
	x=x*8;				
	if(x>127){
		x=0;
		page=page+2;
	}
	OLED_SetPos(x,page);	
	for(i=0;i<8;i++)OLED_WriteData(F8X16[c*16+i]);
	OLED_SetPos(x,page+1);
	for(i=0;i<8;i++)OLED_WriteData(F8X16[c*16+i+8]);	
}
void OLED_ShowString(Uchar x,Uchar y,char *s){
	int p=0;
	while(*(s+p)!='\0'){
		OLED_ShowChar(x+p,y,*(s+p));
		p++;
	}
}
void OLED_ShowNum(Uchar x,Uchar y,int n,Uchar len){
	int p=0;
	if(n<0){
		OLED_ShowChar(x,y,'-');
		n=-n;
	}else{
		OLED_ShowChar(x,y,' ');
	}
	if(n==0){
		OLED_ShowChar(x+len-1,y,'0');
		p++;
	}
	while(n>0&&p<len){
		OLED_ShowChar(x+len-p-1,y,n%10+48);
		p++;
		n=n/10;
	}
	while(p<len-1){
		OLED_ShowChar(x+len-p-1,y,' ');
		p++;
	}
	
}
void OLED_Clean(void){
	Uchar i,j;
	Uint k=0;
	for(j=0;j<8;j++){
		OLED_WriteCommand(0x22);
		OLED_WriteCommand(j);
		OLED_WriteCommand(0x07);
 		for(i=0;i<128;i++){
			OLED_WriteData(0);
			k=k+1;
		}
	}
}
void OLED_ShowFloat(uint8_t x,uint8_t y,float num,uint8_t n){
    uint8_t a,cnt;
	float b;
	cnt=0;
	b=num-(uint8_t)num;
	a=(uint8_t)num;
	while(a){
		a/=10;
		cnt++;
	}
	if(cnt==0){
		OLED_ShowChar(x,y,'0');
		cnt++;
	}
	OLED_ShowChar(x,y,((uint8_t)num)+'0');
	OLED_ShowChar(x+cnt,y,'.');
	cnt++;
	while(1){
		OLED_ShowChar(x+cnt,y,((int)(b*10))+'0');
		cnt++;
		b=b*10-(uint8_t)(b*10);
		if(cnt==n+1){
			break;
		}
	}
}
void OLED_ShowCHinese(uint8_t x,uint8_t y,uint8_t no)//x(0 to 127) y(0 to 6)
{      			    
	uint8_t t,adder=0;
	OLED_SetPos(x,y);//显示文字的坐标	
    for(t=0;t<16;t++)
		{
				OLED_WriteData(Hzk[2*no][t]);
				adder+=1;
    }	
		OLED_SetPos(x,y+1);	
    for(t=0;t<16;t++)
		{	
			OLED_WriteData(Hzk[2*no+1][t]);
			adder+=1;
    }					
}
